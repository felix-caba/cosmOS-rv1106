## board/luckfox_pico_defconfig
```kconfig
BR2_arm=y
BR2_cortex_a7=y

#BR2_TOOLCHAIN_EXTERNAL=y
#BR2_TOOLCHAIN_EXTERNAL_CUSTOM=y
#BR2_TOOLCHAIN_EXTERNAL_PATH="../tools/linux/toolchain/arm-rockchip830-linux-uclibcgnueabihf"
#BR2_TOOLCHAIN_EXTERNAL_CUSTOM_PREFIX="arm-rockchip830-linux-uclibcgnueabihf"
#BR2_TOOLCHAIN_EXTERNAL_GCC_8=y
#BR2_TOOLCHAIN_EXTERNAL_HEADERS_5_10=y
#BR2_TOOLCHAIN_EXTERNAL_WCHAR=y
#BR2_TOOLCHAIN_EXTERNAL_HAS_SSP=y
#BR2_TOOLCHAIN_EXTERNAL_CXX=y

# --- INICIO: Configuración del Kernel Local ---
BR2_LINUX_KERNEL=y
# Especifica que use una fuente local
BR2_LINUX_KERNEL_OVERRIDE_SRCDIR="$(TOPDIR)/../kernel"
# Especifica qué defconfig USAR DENTRO de tu directorio kernel/
BR2_LINUX_KERNEL_CUSTOM_CONFIG_FILE="../kernel/arch/arm/configs/rv1106_defconfig"
BR2_LINUX_KERNEL_USE_DEFCONFIG=y
BR2_LINUX_KERNEL_DEFCONFIG="rv1106" # Usa el nombre base
# Especifica qué DTB compilar DESDE tu directorio kernel/
BR2_LINUX_KERNEL_DTS_SUPPORT=y
BR2_LINUX_KERNEL_INTREE_DTS_NAME="rockchip/rv1106g-luckfox-pico-pro" # Ajusta si es necesario
# --- FIN: Configuración del Kernel Local ---

BR2_PRIMARY_SITE="http://sources.buildroot.net"
BR2_OPTIMIZE_3=y
BR2_TARGET_GENERIC_HOSTNAME="cosmOS"
BR2_TARGET_GENERIC_ISSUE="Welcome to cosmOS"
BR2_TARGET_GENERIC_ROOT_PASSWD="cosmos"
BR2_SYSTEM_ENABLE_NLS=y
BR2_PACKAGE_BUSYBOX_SHOW_OTHERS=y
BR2_PACKAGE_E2FSPROGS=y
BR2_PACKAGE_E2FSPROGS_RESIZE2FS=y
BR2_PACKAGE_EVTEST=y
BR2_PACKAGE_PYTHON3=y
BR2_PACKAGE_PYTHON3_SSL=y
BR2_PACKAGE_PYTHON_AIOHTTP=y
BR2_PACKAGE_PYTHON_CLICK=y
BR2_PACKAGE_PYTHON_ITSDANGEROUS=y
BR2_PACKAGE_PYTHON_JINJA2=y
BR2_PACKAGE_PYTHON_PERIPHERY=y
BR2_PACKAGE_PYTHON_PILLOW=y
BR2_PACKAGE_PYTHON_SERIAL=y
BR2_PACKAGE_PYTHON_SETUPTOOLS=y
BR2_PACKAGE_PYTHON_SMBUS_CFFI=y
BR2_PACKAGE_PYTHON_SPIDEV=y
BR2_PACKAGE_PYTHON_WERKZEUG=y
BR2_PACKAGE_GNUTLS=y
BR2_PACKAGE_LIBMD=y
BR2_PACKAGE_FREETYPE=y
BR2_PACKAGE_LIBDRM=y
BR2_PACKAGE_DTC=y
BR2_PACKAGE_DTC_PROGRAMS=y
BR2_PACKAGE_LIBV4L=y
BR2_PACKAGE_LIBV4L_UTILS=y
BR2_PACKAGE_IPERF=y
BR2_PACKAGE_IPERF3=y
BR2_PACKAGE_LRZSZ=y
BR2_PACKAGE_NTP=y
BR2_PACKAGE_OPENSSH=y
BR2_PACKAGE_SOCAT=y
BR2_PACKAGE_BASH=y
BR2_PACKAGE_BASH_LOADABLE_EXAMPLES=y
BR2_PACKAGE_DIALOG=y
BR2_PACKAGE_TIME=y
BR2_PACKAGE_HTOP=y
BR2_PACKAGE_UTIL_LINUX_LIBMOUNT=y
BR2_PACKAGE_NANO=y
BR2_PACKAGE_HOST_DTC=y
```
